#include "anywhy_flake.dtsi"

&kscan0 {
    col-gpios
    = <&xiao_d 2 GPIO_ACTIVE_HIGH>
    , <&xiao_d 1 GPIO_ACTIVE_HIGH>
    , <&xiao_d 0 GPIO_ACTIVE_HIGH>
    , <&xiao_d 3 GPIO_ACTIVE_HIGH>
    , <&xiao_d 4 GPIO_ACTIVE_HIGH>
    , <&xiao_d 5 GPIO_ACTIVE_HIGH>
    ;
};

/* Force Studio to use only the USB transport to avoid extra serial ports. */
&zephyr_user {
    zmk,studio-transports = <&studio_usb>;
};

&studio_uart {
    status = "disabled";
};
